## Kconfig
```kconfig
menu "Ethernet Driver"
    config ETHERNET_DRIVER_GPIO_RANGE_MIN
        int "GPIO Range Min"
        default 0

    config ETHERNET_DRIVER_GPIO_RANGE_MAX
        int "GPIO Range Max"
        default 39 if IDF_TARGET_ESP32
        default 46 if IDF_TARGET_ESP32S2
        default 19 if IDF_TARGET_ESP32C3
        default 48 if IDF_TARGET_ESP32S3

    config ETHERNET_DRIVER_USE_INTERNAL_ETHERNET
        depends on IDF_TARGET_ESP32
        select ETH_USE_ESP32_EMAC
        bool "Internal EMAC"
        default n
        help
            Use internal Ethernet MAC controller.

if ETHERNET_DRIVER_USE_INTERNAL_ETHERNET
    choice ETHERNET_DRIVER_PHY_MODEL
        prompt "Ethernet PHY Device"
        default ETHERNET_DRIVER_PHY_IP101
        help
            Select the Ethernet PHY device to use in the example.

        config ETHERNET_DRIVER_PHY_IP101
            bool "IP101"
            help
                IP101 is a single port 10/100 MII/RMII/TP/Fiber Fast Ethernet Transceiver.
                Goto http://www.icplus.com.tw/pp-IP101G.html for more information about it.

        config ETHERNET_DRIVER_PHY_RTL8201
            bool "RTL8201/SR8201"
            help
                RTL8201F/SR8201F is a single port 10/100Mb Ethernet Transceiver with auto MDIX.
                Goto http://www.corechip-sz.com/productsview.asp?id=22 for more information about it.

        config ETHERNET_DRIVER_PHY_LAN87XX
            bool "LAN87xx"
            help
                Below chips are supported:
                LAN8710A is a small footprint MII/RMII 10/100 Ethernet Transceiver with HP Auto-MDIX and
                    flexPWR® Technology.
                LAN8720A is a small footprint RMII 10/100 Ethernet Transceiver with HP Auto-MDIX Support.
                LAN8740A/LAN8741A is a small footprint MII/RMII 10/100 Energy Efficient Ethernet Transceiver
                    with HP Auto-MDIX and flexPWR® Technology.
                LAN8742A is a small footprint RMII 10/100 Ethernet Transceiver with HP Auto-MDIX and
                    flexPWR® Technology.
                Goto https://www.microchip.com for more information about them.

        config ETHERNET_DRIVER_PHY_DP83848
            bool "DP83848"
            help
                DP83848 is a single port 10/100Mb/s Ethernet Physical Layer Transceiver.
                Goto http://www.ti.com/product/DP83848J for more information about it.

        config ETHERNET_DRIVER_PHY_KSZ8041
            bool "KSZ8041"
            help
                The KSZ8041 is a single supply 10Base-T/100Base-TX Physical Layer Transceiver.
                Goto https://www.microchip.com/wwwproducts/en/KSZ8041 for more information about it.

        config ETHERNET_DRIVER_PHY_KSZ8081
            bool "KSZ8081"
            help
                The KSZ8081 is a single supply 10Base-T/100Base-TX Physical Layer Transceiver.
                Goto https://www.microchip.com/wwwproducts/en/KSZ8081 for more information about it.
    endchoice # ETHERNET_DRIVER_PHY_MODEL

    config ETHERNET_DRIVER_MDC_GPIO
        int "SMI MDC GPIO number"
        range ETHERNET_DRIVER_GPIO_RANGE_MIN ETHERNET_DRIVER_GPIO_RANGE_MAX
        default 23
        help
            Set the GPIO number used by SMI MDC.

    config ETHERNET_DRIVER_MDIO_GPIO
        int "SMI MDIO GPIO number"
        range ETHERNET_DRIVER_GPIO_RANGE_MIN ETHERNET_DRIVER_GPIO_RANGE_MAX
        default 18
        help
            Set the GPIO number used by SMI MDIO.

    config ETHERNET_DRIVER_PHY_RST_GPIO
        int "PHY Reset GPIO number"
        range -1 ETHERNET_DRIVER_GPIO_RANGE_MAX
        default 5
        help
            Set the GPIO number used to reset PHY chip.
            Set to -1 to disable PHY chip hardware reset.

    config ETHERNET_DRIVER_PHY_ADDR
        int "PHY Address"
        range 0 31
        default 1
        help
            Set PHY address according your board schematic.
endif # ETHERNET_DRIVER_USE_INTERNAL_ETHERNET

    config ETHERNET_DRIVER_USE_SPI_ETHERNET
        bool "SPI Ethernet"
        default y
        select ETH_USE_SPI_ETHERNET
        help
            Use external SPI-Ethernet module(s).

if ETHERNET_DRIVER_USE_SPI_ETHERNET
    config ETHERNET_DRIVER_SPI_ETHERNETS_NUM
        int "Number of SPI Ethernet modules to use at a time"
        range 1 2
        default 1
        help
            Set the number of SPI Ethernet modules you want to use at a time. Multiple SPI modules can be connected
            to one SPI interface and can be separately accessed based on state of associated Chip Select (CS).

    choice ETHERNET_DRIVER_ETHERNET_TYPE_SPI
        prompt "Ethernet SPI"
        default ETHERNET_DRIVER_USE_W5500
        help
            Select which kind of Ethernet will be used in the example.

        config ETHERNET_DRIVER_USE_DM9051
            bool "DM9051 Module"
            select ETH_SPI_ETHERNET_DM9051
            help
                Select external SPI-Ethernet module (DM9051).

        config ETHERNET_DRIVER_USE_KSZ8851SNL
            bool "KSZ8851SNL Module"
            select ETH_SPI_ETHERNET_KSZ8851SNL
            help
                Select external SPI-Ethernet module (KSZ8851SNL).

        config ETHERNET_DRIVER_USE_W5500
            bool "W5500 Module"
            select ETH_SPI_ETHERNET_W5500
            help
                Select external SPI-Ethernet module (W5500).
    endchoice

    config ETHERNET_DRIVER_SPI_HOST
        int "SPI Host Number"
        range 0 2
        default 1
        help
            Set the SPI host used to communicate with the SPI Ethernet Controller.

    config ETHERNET_DRIVER_SPI_SCLK_GPIO
        int "SPI SCLK GPIO number"
        range ETHERNET_DRIVER_GPIO_RANGE_MIN ETHERNET_DRIVER_GPIO_RANGE_MAX
        default 18 if IDF_TARGET_ESP32
        default 12 if IDF_TARGET_ESP32S2 || IDF_TARGET_ESP32S3
        default 6 if IDF_TARGET_ESP32C3
        help
            Set the GPIO number used by SPI SCLK.

    config ETHERNET_DRIVER_SPI_MOSI_GPIO
        int "SPI MOSI GPIO number"
        range ETHERNET_DRIVER_GPIO_RANGE_MIN ETHERNET_DRIVER_GPIO_RANGE_MAX
        default 23 if IDF_TARGET_ESP32
        default 11 if IDF_TARGET_ESP32S2 || IDF_TARGET_ESP32S3
        default 7 if IDF_TARGET_ESP32C3
        help
            Set the GPIO number used by SPI MOSI.

    config ETHERNET_DRIVER_SPI_MISO_GPIO
        int "SPI MISO GPIO number"
        range ETHERNET_DRIVER_GPIO_RANGE_MIN ETHERNET_DRIVER_GPIO_RANGE_MAX
        default 19 if IDF_TARGET_ESP32
        default 13 if IDF_TARGET_ESP32S2 || IDF_TARGET_ESP32S3
        default 2 if IDF_TARGET_ESP32C3
        help
            Set the GPIO number used by SPI MISO.

    config ETHERNET_DRIVER_SPI_CLOCK_MHZ
        int "SPI clock speed (MHz)"
        range 5 80
        default 22 if IDF_TARGET_ESP32 || IDF_TARGET_ESP32C3
        default 36 if IDF_TARGET_ESP32S2 || IDF_TARGET_ESP32S3
        help
            Set the clock speed (MHz) of SPI interface.

    config ETHERNET_DRIVER_SPI_CS0_GPIO
        int "SPI CS0 GPIO number for SPI Ethernet module #1"
        range ETHERNET_DRIVER_GPIO_RANGE_MIN ETHERNET_DRIVER_GPIO_RANGE_MAX
        default 5 if IDF_TARGET_ESP32
        default 10 if IDF_TARGET_ESP32S2 || IDF_TARGET_ESP32C3 || IDF_TARGET_ESP32S3
        help
            Set the GPIO number used by SPI CS0, i.e. Chip Select associated with the first SPI Eth module).

    config ETHERNET_DRIVER_SPI_CS1_GPIO
        depends on ETHERNET_DRIVER_SPI_ETHERNETS_NUM > 1
        int "SPI CS1 GPIO number for SPI Ethernet module #2"
        range ETHERNET_DRIVER_GPIO_RANGE_MIN ETHERNET_DRIVER_GPIO_RANGE_MAX
        default 32 if IDF_TARGET_ESP32
        default 7 if IDF_TARGET_ESP32S2 || IDF_TARGET_ESP32S3
        default 8 if IDF_TARGET_ESP32C3
        help
            Set the GPIO number used by SPI CS1, i.e. Chip Select associated with the second SPI Eth module.

    config ETHERNET_DRIVER_SPI_INT0_GPIO
        int "Interrupt GPIO number SPI Ethernet module #1"
        range ETHERNET_DRIVER_GPIO_RANGE_MIN ETHERNET_DRIVER_GPIO_RANGE_MAX
        default 34 if IDF_TARGET_ESP32 || IDF_TARGET_ESP32S2 || IDF_TARGET_ESP32C3 || IDF_TARGET_ESP32S3
        help
            Set the GPIO number used by the first SPI Ethernet module interrupt line.

    config ETHERNET_DRIVER_SPI_INT1_GPIO
        depends on ETHERNET_DRIVER_SPI_ETHERNETS_NUM > 1
        int "Interrupt GPIO number SPI Ethernet module #2"
        range ETHERNET_DRIVER_GPIO_RANGE_MIN ETHERNET_DRIVER_GPIO_RANGE_MAX
        default 33 if IDF_TARGET_ESP32
        default 5 if IDF_TARGET_ESP32S2 || IDF_TARGET_ESP32C3 || IDF_TARGET_ESP32S3
        help
            Set the GPIO number used by the second SPI Ethernet module interrupt line.

    config ETHERNET_DRIVER_SPI_PHY_RST0_GPIO
        int "PHY Reset GPIO number of SPI Ethernet Module #1"
        range -1 ETHERNET_DRIVER_GPIO_RANGE_MAX
        default 2
        help
            Set the GPIO number used to reset PHY chip on the first SPI Ethernet module.
            Set to -1 to disable PHY chip hardware reset.

    config ETHERNET_DRIVER_SPI_PHY_RST1_GPIO
        depends on ETHERNET_DRIVER_SPI_ETHERNETS_NUM > 1
        int "PHY Reset GPIO number of SPI Ethernet Module #2"
        range -1 ETHERNET_DRIVER_GPIO_RANGE_MAX
        default -1
        help
            Set the GPIO number used to reset PHY chip on the second SPI Ethernet module.
            Set to -1 to disable PHY chip hardware reset.

    config ETHERNET_DRIVER_SPI_PHY_ADDR0
        int "PHY Address of SPI Ethernet Module #1"
        range 0 31
        default 1
        help
            Set the first SPI Ethernet module PHY address according your board schematic.

    config ETHERNET_DRIVER_SPI_PHY_ADDR1
        depends on ETHERNET_DRIVER_SPI_ETHERNETS_NUM > 1
        int "PHY Address of SPI Ethernet Module #2"
        range 0 31
        default 1
        help
            Set the second SPI Ethernet module PHY address according your board schematic.
endif # ETHERNET_DRIVER_USE_SPI_ETHERNET
endmenu
```
